// Kết nối: SPI1 - PA5(SCK), PA7(MOSI), PA4(CS), PA3(DC), PA2(RST)

#include <stdint.h>

// ==================== Địa chỉ Base ====================
#define PERIPH_BASE           0x40000000UL
#define APB2PERIPH_BASE       (PERIPH_BASE + 0x10000UL)
#define AHBPERIPH_BASE        (PERIPH_BASE + 0x20000UL)

// ==================== RCC ====================
#define RCC_BASE              (AHBPERIPH_BASE + 0x1000UL)
#define RCC_APB2ENR           (*(volatile uint32_t *)(RCC_BASE + 0x18))

#define RCC_APB2ENR_IOPAEN    (1 << 2)
#define RCC_APB2ENR_SPI1EN    (1 << 12)

// ==================== GPIOA ====================
#define GPIOA_BASE            (APB2PERIPH_BASE + 0x0800UL)
#define GPIOA_CRL             (*(volatile uint32_t *)(GPIOA_BASE + 0x00))
#define GPIOA_CRH             (*(volatile uint32_t *)(GPIOA_BASE + 0x04))
#define GPIOA_BSRR            (*(volatile uint32_t *)(GPIOA_BASE + 0x10))

// ==================== SPI1 ====================
#define SPI1_BASE             (APB2PERIPH_BASE + 0x3000UL)
#define SPI1_CR1              (*(volatile uint32_t *)(SPI1_BASE + 0x00))
#define SPI1_SR               (*(volatile uint32_t *)(SPI1_BASE + 0x08))
#define SPI1_DR               (*(volatile uint32_t *)(SPI1_BASE + 0x0C))

// SPI_CR1 bits
#define SPI_CR1_MSTR          (1 << 2)
#define SPI_CR1_BR_1          (1 << 4)
#define SPI_CR1_SPE           (1 << 6)
#define SPI_CR1_SSI           (1 << 8)
#define SPI_CR1_SSM           (1 << 9)

// SPI_SR bits
#define SPI_SR_RXNE           (1 << 0)
#define SPI_SR_TXE            (1 << 1)

// ==================== GPIO Control ====================
#define OLED_CS_LOW()         GPIOA_BSRR = (1 << 20)  // PA4 reset
#define OLED_CS_HIGH()        GPIOA_BSRR = (1 << 4)   // PA4 set
#define OLED_DC_LOW()         GPIOA_BSRR = (1 << 19)  // PA3 reset (Command)
#define OLED_DC_HIGH()        GPIOA_BSRR = (1 << 3)   // PA3 set (Data)
#define OLED_RST_LOW()        GPIOA_BSRR = (1 << 18)  // PA2 reset
#define OLED_RST_HIGH()       GPIOA_BSRR = (1 << 2)   // PA2 set

// ==================== Font 8x8 ====================
const uint8_t font8x8[95][8] = {
    {0x00,0x00,0x00,0x00,0x00,0x00,0x00,0x00}, // Space
    {0x00,0x00,0x5F,0x00,0x00,0x00,0x00,0x00}, // !
    {0x00,0x07,0x00,0x07,0x00,0x00,0x00,0x00}, // "
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    {0x61,0x51,0x49,0x45,0x43,0x00,0x00,0x00}, // Z
};

// ==================== Delay ====================
void delay_ms(uint32_t ms) {
    for(uint32_t i = 0; i < ms * 8000; i++) {
        __asm("nop");
    }
}

// ==================== Khởi tạo RCC ====================
void OLED_RCC_Init(void) {
    RCC_APB2ENR |= RCC_APB2ENR_IOPAEN;    // Enable GPIOA clock
    RCC_APB2ENR |= RCC_APB2ENR_SPI1EN;    // Enable SPI1 clock
}

// ==================== Khởi tạo GPIO ====================
void OLED_GPIO_Init(void) {
    // PA2 (RST) - Output push-pull 50MHz
    GPIOA_CRL &= ~(0xF << 8);
    GPIOA_CRL |= (0x3 << 8);

    // PA3 (DC) - Output push-pull 50MHz
    GPIOA_CRL &= ~(0xF << 12);
    GPIOA_CRL |= (0x3 << 12);

    // PA4 (CS) - Output push-pull 50MHz
    GPIOA_CRL &= ~(0xF << 16);
    GPIOA_CRL |= (0x3 << 16);

    // PA5 (SCK) - Alternate function push-pull 50MHz
    GPIOA_CRL &= ~(0xF << 20);
    GPIOA_CRL |= (0xB << 20);

    // PA7 (MOSI) - Alternate function push-pull 50MHz
    GPIOA_CRL &= ~(0xF << 28);
    GPIOA_CRL |= (0xB << 28);
}

// ==================== Khởi tạo SPI1 ====================
void OLED_SPI_Init(void) {
    SPI1_CR1 = 0;
    SPI1_CR1 |= SPI_CR1_MSTR;      // Master mode
    SPI1_CR1 |= SPI_CR1_BR_1;      // Baud rate = fPCLK/8
    SPI1_CR1 |= SPI_CR1_SSM;       // Software slave management
    SPI1_CR1 |= SPI_CR1_SSI;       // Internal slave select
    SPI1_CR1 |= SPI_CR1_SPE;       // SPI enable
}

// ==================== Gửi byte qua SPI ====================
void SPI_Write(uint8_t data) {
    while(!(SPI1_SR & SPI_SR_TXE));
    SPI1_DR = data;
    while(!(SPI1_SR & SPI_SR_RXNE));
    (void)SPI1_DR;
}

// ==================== OLED Functions ====================
void OLED_WriteCmd(uint8_t cmd) {
    OLED_CS_LOW();
    OLED_DC_LOW();
    SPI_Write(cmd);
    OLED_CS_HIGH();
}

void OLED_WriteData(uint8_t data) {
    OLED_CS_LOW();
    OLED_DC_HIGH();
    SPI_Write(data);
    OLED_CS_HIGH();
}

void OLED_Init(void) {
    OLED_RST_HIGH();
    delay_ms(1);
    OLED_RST_LOW();
    delay_ms(10);
    OLED_RST_HIGH();
    delay_ms(10);

    OLED_WriteCmd(0xAE); // Display OFF
    OLED_WriteCmd(0x20); // Set Memory Addressing Mode
    OLED_WriteCmd(0x00); // Horizontal Addressing Mode
    OLED_WriteCmd(0xB0); // Set Page Start Address
    OLED_WriteCmd(0xC8); // Set COM Output Scan Direction
    OLED_WriteCmd(0x00); // Set low column address
    OLED_WriteCmd(0x10); // Set high column address
    OLED_WriteCmd(0x40); // Set start line address
    OLED_WriteCmd(0x81); // Set contrast control register
    OLED_WriteCmd(0xFF);
    OLED_WriteCmd(0xA1); // Set segment re-map
    OLED_WriteCmd(0xA6); // Set normal display
    OLED_WriteCmd(0xA8); // Set multiplex ratio
    OLED_WriteCmd(0x3F);
    OLED_WriteCmd(0xA4); // Output follows RAM content
    OLED_WriteCmd(0xD3); // Set display offset
    OLED_WriteCmd(0x00);
    OLED_WriteCmd(0xD5); // Set display clock divide ratio
    OLED_WriteCmd(0xF0);
    OLED_WriteCmd(0xD9); // Set pre-charge period
    OLED_WriteCmd(0x22);
    OLED_WriteCmd(0xDA); // Set com pins hardware configuration
    OLED_WriteCmd(0x12);
    OLED_WriteCmd(0xDB); // Set vcomh
    OLED_WriteCmd(0x20);
    OLED_WriteCmd(0x8D); // Set DC-DC enable
    OLED_WriteCmd(0x14);
    OLED_WriteCmd(0xAF); // Display ON
}

void OLED_Clear(void) {
    for(uint8_t page = 0; page < 8; page++) {
        OLED_WriteCmd(0xB0 + page);
        OLED_WriteCmd(0x00);
        OLED_WriteCmd(0x10);
        for(uint8_t col = 0; col < 128; col++) {
            OLED_WriteData(0x00);
        }
    }
}

void OLED_SetPos(uint8_t x, uint8_t y) {
    OLED_WriteCmd(0xB0 + y);
    OLED_WriteCmd(((x & 0xF0) >> 4) | 0x10);
    OLED_WriteCmd(x & 0x0F);
}

void OLED_ShowChar(uint8_t x, uint8_t y, char chr) {
    uint8_t c = chr - ' ';
    if(c > 94) c = 0;

    OLED_SetPos(x, y);
    for(uint8_t i = 0; i < 8; i++) {
        OLED_WriteData(font8x8[c][i]);
    }
}

void OLED_ShowString(uint8_t x, uint8_t y, char *str) {
    uint8_t pos = x;
    while(*str != '\0') {
        OLED_ShowChar(pos, y, *str);
        pos += 8;
        str++;
    }
}

int main(void) {
    OLED_RCC_Init();
    OLED_GPIO_Init();
    OLED_SPI_Init();
    OLED_Init();

    OLED_Clear();

    OLED_ShowString(24, 2, "28/12/2024");

    OLED_ShowString(32, 5, "23:45:30");

    while(1) {

    }
}
